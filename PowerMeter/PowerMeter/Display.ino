#define SCREEN_WIDTH 128 // OLED display width, in pixels
#define SCREEN_HEIGHT 64 // OLED display height, in pixels

// Declaration for an SSD1306 display connected to I2C (SDA, SCL pins)
#define OLED_RESET     -1 // Reset pin # (or -1 if sharing Arduino reset pin)
Adafruit_SSD1306 display(SCREEN_WIDTH, SCREEN_HEIGHT, &Wire, OLED_RESET);


// 'sat', 16x16px
const unsigned char PROGMEM sat []  = {
	0x00, 0x00, 0x00, 0x00, 0x0c, 0x00, 0x0f, 0xf8, 0x1e, 0x38, 0x1f, 0x40, 0x1f, 0x80, 0x1f, 0x90, 
	0x1f, 0xd0, 0x0f, 0xe0, 0x0f, 0xf0, 0x07, 0xf0, 0x18, 0x00, 0x3c, 0x00, 0x3c, 0x00, 0x00, 0x00
};


static const unsigned char PROGMEM WiFiFull[] = {
  0x00, 0x00, 0x7f, 0xfe, 0x7f, 0xfe, 0x00, 0x00, 0x1f, 0xfc, 0x1f, 0xfc, 0x00, 0x00, 0x07, 0xf0, 
  0x07, 0xf0, 0x00, 0x00, 0x01, 0xc0, 0x01, 0xc0, 0x00, 0x00, 
};


static const unsigned char PROGMEM Rega[] = {
  0x00, 0x00, 0x00, 0x00, 0x00, 0x00, 0x00, 0x00, 0x00, 0x00, 0x00, 0x80, 0x00, 0x00, 0x01, 0x80, 
  0x00, 0x00, 0x01, 0xc0, 0x00, 0x00, 0x03, 0xc0, 0x00, 0x00, 0x03, 0xe0, 0x00, 0x00, 0x07, 0xe0, 
  0x00, 0x00, 0x0f, 0xf0, 0x00, 0x00, 0x0f, 0xf8, 0x00, 0x00, 0x1f, 0xf8, 0x00, 0x00, 0x1f, 0xfc, 
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  0x00, 0x00, 0x00, 0x00, 
};

static const unsigned char PROGMEM Idle[] = {
  0x00, 0x00, 0x00, 0x00, 0x00, 0x00, 0x00, 0x00, 0x00, 0x00, 0x00, 0x00, 0x00, 0x00, 0x70, 0x00, 
  0x00, 0x00, 0xf8, 0x00, 0x00, 0x38, 0xf8, 0x00, 0x00, 0x7e, 0xf8, 0x00, 0x00, 0x7f, 0xf8, 0x00, 
  0x00, 0x7f, 0xf3, 0x80, 0x00, 0x3f, 0xff, 0xc0, 0x00, 0x1f, 0xff, 0xe0, 0x00, 0x3f, 0x7f, 0xe0, 
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  0x00, 0x00, 0x00, 0x00, 0x00, 0x00, 0x00, 0x00, 
};



void SetupDisplay()
{
  // SSD1306_SWITCHCAPVCC = generate display voltage from 3.3V internally
  if(!display.begin(SSD1306_SWITCHCAPVCC, 0x3C)) { 
    Serial.println(F("SSD1306 allocation failed"));
  }
}

void DisplayStatus()
{
  
    display.clearDisplay();

    //Full wifi Signal
 
    if (gps.satellites() != TinyGPS::GPS_INVALID_SATELLITES && (! timeSync ))
      {
        display.drawBitmap(128-16-1, 0, sat, 16, 16, WHITE);
      }
   

     
/*
     // Internet
      display.setTextSize(2); // Draw 2X-scale text
      display.setTextColor(WHITE);
      display.setCursor(30, 0);
      display.print(F("I"));
    

    //Hora
      display.setTextSize(2); // Draw 2X-scale text
      display.setTextColor(WHITE);
      display.setCursor(50, 0);
      display.print(F("Ntp"));

*/    


  float shuntvoltage = 0;
  float busvoltage = 0;
  float current_mA = 0;
  float loadvoltage = 0;
  float power_mW = 0;
 
  shuntvoltage = ina219.getShuntVoltage_mV();
  busvoltage = ina219.getBusVoltage_V();
  current_mA = ina219.getCurrent_mA();
  power_mW = ina219.getPower_mW();
  loadvoltage = busvoltage + (shuntvoltage / 1000);
 
     if (! timeSync)
      {
       display.setTextSize(2); // Draw 2X-scale text
       display.setTextColor(WHITE);
       display.setCursor(0, 0);
       sprintf(buffer, PSTR("%02d:%02d:%02d"), hour(), minute(), second() );
       display.print(buffer);

       sprintf(buffer, PSTR("Wait Gps"));

       display.setTextSize(2); // Draw 2X-scale text
       display.setTextColor(WHITE);
       display.setCursor(15, 30);
       display.println(buffer);
      }
    else
      {
       display.setTextSize(2); // Draw 2X-scale text

       display.setTextColor(WHITE);
       display.setCursor(0, 0);
       display.print((int) power_mW);
       display.print(" mW");

       display.setTextColor(WHITE);
       display.setCursor(0, 20);
       display.print((float) loadvoltage);
       display.print(" V");

       display.setTextColor(WHITE);
       display.setCursor(0, 40);
       display.print((int) current_mA);
       display.print(" mA");
      }

    display.display();
}
