#define SCREEN_WIDTH 128 // OLED display width, in pixels
#define SCREEN_HEIGHT 64 // OLED display height, in pixels

// Declaration for an SSD1306 display connected to I2C (SDA, SCL pins)
#define OLED_RESET     -1 // Reset pin # (or -1 if sharing Arduino reset pin)
Adafruit_SSD1306 display(SCREEN_WIDTH, SCREEN_HEIGHT, &Wire, OLED_RESET);


/*
#define NUMFLAKES     10 // Number of snowflakes in the animation example

#define LOGO_HEIGHT   16
#define LOGO_WIDTH    16
static const unsigned char PROGMEM logo_bmp[] =
{ B00000000, B11000000,
  B00000001, B11000000,
  B00000001, B11000000,
  B00000011, B11100000,
  B11110011, B11100000,
  B11111110, B11111000,
  B01111110, B11111111,
  B00110011, B10011111,
  B00011111, B11111100,
  B00001101, B01110000,
  B00011011, B10100000,
  B00111111, B11100000,
  B00111111, B11110000,
  B01111100, B11110000,
  B01110000, B01110000,
  B00000000, B00110000 }; */

static const unsigned char PROGMEM WiFiFull[] = {
  0x00, 0x00, 0x7f, 0xfe, 0x7f, 0xfe, 0x00, 0x00, 0x1f, 0xfc, 0x1f, 0xfc, 0x00, 0x00, 0x07, 0xf0, 
  0x07, 0xf0, 0x00, 0x00, 0x01, 0xc0, 0x01, 0xc0, 0x00, 0x00, 
};


static const unsigned char PROGMEM Rega[] = {
  0x00, 0x00, 0x00, 0x00, 0x00, 0x00, 0x00, 0x00, 0x00, 0x00, 0x00, 0x80, 0x00, 0x00, 0x01, 0x80, 
  0x00, 0x00, 0x01, 0xc0, 0x00, 0x00, 0x03, 0xc0, 0x00, 0x00, 0x03, 0xe0, 0x00, 0x00, 0x07, 0xe0, 
  0x00, 0x00, 0x0f, 0xf0, 0x00, 0x00, 0x0f, 0xf8, 0x00, 0x00, 0x1f, 0xf8, 0x00, 0x00, 0x1f, 0xfc, 
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  0x00, 0x00, 0x00, 0x00, 
};

static const unsigned char PROGMEM Idle[] = {
  0x00, 0x00, 0x00, 0x00, 0x00, 0x00, 0x00, 0x00, 0x00, 0x00, 0x00, 0x00, 0x00, 0x00, 0x70, 0x00, 
  0x00, 0x00, 0xf8, 0x00, 0x00, 0x38, 0xf8, 0x00, 0x00, 0x7e, 0xf8, 0x00, 0x00, 0x7f, 0xf8, 0x00, 
  0x00, 0x7f, 0xf3, 0x80, 0x00, 0x3f, 0xff, 0xc0, 0x00, 0x1f, 0xff, 0xe0, 0x00, 0x3f, 0x7f, 0xe0, 
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  0x00, 0x00, 0x00, 0x00, 0x00, 0x00, 0x00, 0x00, 
};



void SetupDisplay()
{
  // SSD1306_SWITCHCAPVCC = generate display voltage from 3.3V internally
  if(!display.begin(SSD1306_SWITCHCAPVCC, 0x3C)) { 
    Serial.println(F("SSD1306 allocation failed"));
  }
}

void DisplayStatus()
{
    char buffer[200];
    
    display.clearDisplay();

    //Full wifi Signal
 
    if (WiFi.status() == WL_CONNECTED)
      {
        display.drawBitmap(128-16-1, 0, WiFiFull, 16, 13, WHITE);
      }

    int activeRelay=-1;

    for (int relayId = 0; relayId < nRelays; relayId++)
     {
        if (relayStatus[relayId].duration > 0)
        {
          activeRelay = relayId;
        }
     }

    if (activeRelay >= 0 && activeRelay < nRelays)
    {
      display.drawBitmap(0, 64-45-1, Rega, 32, 45, WHITE);

      unsigned long currentMillis = relayStatus[activeRelay].duration - millis();

      if (currentMillis < 0) currentMillis = 0;
      unsigned long sec = currentMillis / 1000;
      unsigned long min = sec / 60;
      unsigned long hr = min / 60;
      sec %= 60;
      min %= 60;
      hr %= 24;

      sprintf(buffer,PSTR("%02d:%02d:%02d"), hr, min, sec);
  
      display.setTextSize(2); // Draw 2X-scale text
      display.setTextColor(WHITE);
      display.setCursor(0, 0);
      display.print(buffer);

      display.setTextSize(2); // Draw 2X-scale text
      display.setTextColor(WHITE);
      display.setCursor(64, 30);
      display.println(F("Setor"));
      display.setCursor(84, 50);
      display.println(activeRelay+1);
    }
    else
    {
     //display.drawBitmap(0, 64-45-1, Idle, 32, 45, WHITE);

     if (mqttClient.connected())
     {
      display.setTextSize(2); // Draw 2X-scale text
      display.setTextColor(WHITE);
      display.setCursor(0, 0);
      display.print(F("Mq"));
     }

     if (internetConnectionState)
     {
      display.setTextSize(2); // Draw 2X-scale text
      display.setTextColor(WHITE);
      display.setCursor(30, 0);
      display.print(F("I"));
     }

     if (ntpSync)
     {
      display.setTextSize(2); // Draw 2X-scale text
      display.setTextColor(WHITE);
      display.setCursor(50, 0);
      display.print(F("Ntp"));
     }

     RtcDateTime now = getLocalDateTime();
     
     sprintf(buffer, PSTR("%02d:%02d:%02d"), now.Hour(), now.Minute(), now.Second() );

      display.setTextSize(2); // Draw 2X-scale text
      display.setTextColor(WHITE);
      display.setCursor(15, 30);
      display.println(buffer);
    }
      
    display.display();
}
